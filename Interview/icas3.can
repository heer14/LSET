/*@!Encoding:1252*/
includes
{
  #include "common.cin"
}

variables
{
  // distance
  msTimer distance_MsTimer;
  char distance_distances_members[4][20] = {"distanceName", "currentValue", "unit", "restrictionReason"};
  word distance_distances_member_types[4] = {0, 0, 0, 0};
    
  // displayspeed
  msTimer displayspeed_MsTimer;
  char displayspeed_velocities_members[8][20] = {"type","currentValue", "unit", "isDisplayActive", "maxValue", "minValue", "resolution", "restrictionReason"};
  word displayspeed_velocities_member_types[8] = {0, 1, 0, 0, 2, 0, 0, 1};
  char displayspeed_notifications_members[8][20] = {"type","isActivated", "threshold", "unit", "restrictionReason", "maxValue", "minValue", "resolution"};
  word displayspeed_notifications_member_types[8] = {0, 2, 0, 2, 0, 0, 0, 0};
  
  // drivingstatistics
  msTimer drivingstatistics_MsTimer;
  char drivingstatistics_speeds_members[3][20] = {"memoryLevel", "currentValue", "state"};
  word drivingstatistics_speeds_member_types[3] = {0, 1, 0};
  char drivingstatistics_distances_members[3][20] = {"currentValue","memoryLevel", "state"};
  word drivingstatistics_distances_member_types[3] = {0, 0, 0};
  char drivingstatistics_durations_members[3][20] = {"currentValue","memoryLevel", "state"};
  word drivingstatistics_durations_member_types[3] = {0, 0, 0};
    
  // electricalconsumptions
  msTimer electricalconsumptions_MsTimer;
  char electricalconsumptions_averageconsumptions_members[3][20] = {"memoryLevel", "physicalValue", "state"};
  word electricalconsumptions_averageconsumptions_member_types[3] = {0, 1, 0};
  char electricalconsumptions_currentconsumptions_members[3][20] = {"state", "physicalValue", "type"};
  word electricalconsumptions_currentconsumptions_member_types[3] = {0, 1, 0};

  // temperature
  msTimer temperature_MsTimer;
  char temperature_temperatures_members[8][20] = {"curentValue", "isValueInvalid", "maxValue", "minValue", "resolution", "restrictionReason", "type", "unit" };
  word temperature_temperatures_member_types[8] = {0, 1, 0, 0, 0, 0, 1, 0};
  char temperature_notifications_members[3][20] = {"isToBeNotified", "temperature", "type"};
  word temperature_notifications_member_types[3] = {0, 2, 1};
  
  // unitmaster
  msTimer unitmaster_MsTimer;
  char unitmaster_units_members[26][40] = {"consumptionUnit", "consumptionUnitElectr", "consumptionUnitGas", "dateFormat", "distanceUnit", "massUnit", "name", "pressureUnit", "restrictionReason", "speedUnit", "speedUnitTachometer", "temperatureUnit", "timeFormat", "volumeUnit", "id", "consumptionUnitConfiguration", "consumptionUnitElectrConfiguration", "consumptionUnitGasConfiguration", "dateFormatConfiguration", "distanceUnitConfiguration", "massUnitConfiguration", "pressureUnitConfiguration", "speedUnitConfiguration", "temperatureUnitConfiguration", "timeFormatConfiguration", "volumeUnitConfiguration"};
  word unitmaster_units_member_types[26] = {0, 0, 0, 0, 0, 0, 3, 0, 0, 0, 0, 0, 0, 0, 11, 10, 10, 10, 10, 10, 10, 10, 10, 10, 10, 10};
  
  // tripcomputer
  msTimer tripcomputer_MsTimer;
  
  dword gMc; // global method call handle
  char icas3_events_sent_namespace[100] = "icas3::services::events::notifications::sent";
}

// handle method TripComputer
void On_TripComputer_getcurrentConsumptionsElementByKey_Request(DWORD methodHandle, DWORD messageHandle, DWORD responseMessageHandle)
{
 write("handl method TripComputer");
}

on start
{
  // initialize IPv6 multicast address
  byte ipv6Address[16];
  ipGetAddressAsArray("ff14::4:0", ipv6Address);  
  SomeIpSetProperty("SDMulticastIPv6", elcount(ipv6Address), ipv6Address);
  
   // initialize tripcomputer
   SomeIpRegisterCallback(SomeIpGetProvidedObjectHandle("TripComputer::getcurrentConsumptionsElementByKey"), "On_TripComputer_getcurrentConsumptionsElementByKey_Request");
  
  // initialize distance
  @icas3::services::events::notifications::send::distance_enabled = 1 - @icas3::services::events::notifications::send::distance_enabled;
  @icas3::services::events::notifications::send::distance_enabled = 1 - @icas3::services::events::notifications::send::distance_enabled;
  
  // initialize displayspeed
  @icas3::services::events::notifications::send::displayspeed_enabled = 1 - @icas3::services::events::notifications::send::displayspeed_enabled;
  @icas3::services::events::notifications::send::displayspeed_enabled = 1 - @icas3::services::events::notifications::send::displayspeed_enabled;

   // initialize drivingstatistics
  @icas3::services::events::notifications::send::drivingstatistics_enabled = 1 - @icas3::services::events::notifications::send::drivingstatistics_enabled;
  @icas3::services::events::notifications::send::drivingstatistics_enabled = 1 - @icas3::services::events::notifications::send::drivingstatistics_enabled;

    // initialize electricalconsumptions
  @icas3::services::events::notifications::send::electricalconsumptions_enabled = 1 - @icas3::services::events::notifications::send::electricalconsumptions_enabled;
  @icas3::services::events::notifications::send::electricalconsumptions_enabled = 1 - @icas3::services::events::notifications::send::electricalconsumptions_enabled;

  // initialize temperature
  @icas3::services::events::notifications::send::temperature_enabled = 1 - @icas3::services::events::notifications::send::temperature_enabled;
  @icas3::services::events::notifications::send::temperature_enabled = 1 - @icas3::services::events::notifications::send::temperature_enabled;

  // initialize unitmaster
  @icas3::services::events::notifications::send::unitmaster_enabled = 1 - @icas3::services::events::notifications::send::unitmaster_enabled;
  @icas3::services::events::notifications::send::unitmaster_enabled = 1 - @icas3::services::events::notifications::send::unitmaster_enabled;

  // initialize tripcomputer
  @icas3::services::events::notifications::send::tripcomputer_enabled = 1 - @icas3::services::events::notifications::send::tripcomputer_enabled;
  @icas3::services::events::notifications::send::tripcomputer_enabled = 1 - @icas3::services::events::notifications::send::tripcomputer_enabled;

   
  // Subscribe to ICAS1 events and register event handler
  
  initialize_event_notifiers();
}

// handle method DiagnosticDataDistribution_getDiagnosticData
on sysvar icas3::services::methods::DiagnosticDataDistribution_getDiagnosticData::send 
{
  if(@this) {
    gMc  = SomeIpGetConsumedObjectHandle("DiagnosticDataDistribution::DiagnosticDataDistribution_getDiagnosticData");
    SomeIpRegisterCallback(gMc, "On_DiagnosticDataDistribution_getDiagnosticData_Response");
    SomeIpSetValueDWord(gMc, "name_space", @icas3::services::methods::DiagnosticDataDistribution_getDiagnosticData::argument_name_space);
    SomeIpSetValueDWord(gMc, "category", @icas3::services::methods::DiagnosticDataDistribution_getDiagnosticData::argument_category);
    SomeIpCallMethod(gMc);
  }
}

// handle method TriggerNotification_getnotificationsElementByKey
on sysvar icas3::services::methods::TriggerNotification_getnotificationsElementByKey::send
{
  if(@this) {
    gMc  = SomeIpGetConsumedObjectHandle("TriggerNotification::getnotificationsElementByKey");
    SomeIpRegisterCallback(gMc, "On_TriggerNotification_getnotificationsElementByKey_Response");
    SomeIpSetValueDWord(gMc, "key", @icas3::services::methods::TriggerNotification_getnotificationsElementByKey::argument_key);
    SomeIpSetValueDWord(gMc, "inParams.key", @icas3::services::methods::TriggerNotification_getnotificationsElementByKey::argument_inParams.key);
    SomeIpSetValueDWord(gMc, "inParams.value", @icas3::services::methods::TriggerNotification_getnotificationsElementByKey::argument_inParams.value);
    SomeIpCallMethod(gMc);
  }
}

void On_TriggerNotification_getnotificationsElementByKey_Response(dword methodCallHandle, dword messageResponseHandle) {
  @icas3::services::methods::TriggerNotification_getnotificationsElementByKey::returnvalue_result::result::returnvalue_outParams.operationStatus  = SomeIpGetValueDWord(messageResponseHandle,"result.result.operationStatus");
  @icas3::services::methods::TriggerNotification_getnotificationsElementByKey::returnvalue_result::result::returnvalue_outParams.notifications = SomeIpGetValueDWord(messageResponseHandle,"result.result.notifications");
  @icas3::services::methods::TriggerNotification_getnotificationsElementByKey::returnvalue_result::result::returnvalue_result.key = SomeIpGetValueDWord(messageResponseHandle,"result.outParams.key");
  @icas3::services::methods::TriggerNotification_getnotificationsElementByKey::returnvalue_result::result::returnvalue_result.value = SomeIpGetValueDWord(messageResponseHandle,"result.outParams.value");
}

void On_DiagnosticDataDistribution_getDiagnosticData_Response(dword methodCallHandle, dword messageResponseHandle) {
  @icas3::services::methods::DiagnosticDataDistribution_getDiagnosticData::returnvalue_dataValuesResult_name_space = SomeIpGetValueDWord(messageResponseHandle,"dataValuesResult[name_space]");
  @icas3::services::methods::DiagnosticDataDistribution_getDiagnosticData::returnvalue_dataValuesResult_category = SomeIpGetValueDWord(messageResponseHandle,"dataValuesResult[category]");
  @icas3::services::methods::DiagnosticDataDistribution_getDiagnosticData::returnvalue_dataValuesResult_hash_value = SomeIpGetValueDWord(messageResponseHandle,"dataValuesResult[hashValue]");
  @icas3::services::methods::DiagnosticDataDistribution_getDiagnosticData::returnvalue_dataValuesResult_length = SomeIpGetValueDWord(messageResponseHandle,"dataValuesResult[length]");
  @icas3::services::methods::DiagnosticDataDistribution_getDiagnosticData::returnvalue_dataValuesResult_diag_return_type = SomeIpGetValueDWord(messageResponseHandle,"dataValuesResult[diagReturnType]");
}

// tripcomputer events
on sysvar sysvar::icas3::services::events::cycletimes::tripcomputer_cycletime {
  if(@icas3::services::events::notifications::send::tripcomputer_enabled) {
    // restart timer for tripcomputer 
    cancelTimer(tripcomputer_MsTimer);
    if( @this ) setTimerCyclic(tripcomputer_MsTimer, @this);
  }
}

on sysvar sysvar::icas3::services::events::notifications::send::tripcomputer_enabled {
  if( @this ) {
    if( !@icas3::services::events::notifications::send::tripcomputer_currentConsumptionsMulticast_enabled ) {
      // enable controls
      @icas3::services::events::notifications::send::tripcomputer_currentConsumptionsMulticast_enabled = 1;
    }
    if( @icas3::services::events::cycletimes::tripcomputer_cycletime ) setTimerCyclic(tripcomputer_MsTimer, @icas3::services::events::cycletimes::tripcomputer_cycletime);
  }
  else {
    cancelTimer(tripcomputer_MsTimer);
  }
  checkboxes_enabled();
}

on timer tripcomputer_MsTimer {
  if(@icas3::services::events::notifications::send::tripcomputer_currentConsumptionsMulticast_enabled) {
    SomeIpTriggerEvent(SomeIpGetProvidedObjectHandle("TripComputer::currentConsumptionsMulticast"));
  }
}

// displayspeed events
on sysvar sysvar::icas3::services::events::cycletimes::displayspeed_cycletime {
  if(@icas3::services::events::notifications::send::displayspeed_enabled) {
    // restart timer for distance 
    cancelTimer(displayspeed_MsTimer);
    if( @this ) setTimerCyclic(displayspeed_MsTimer, @this);
  }
}

on sysvar sysvar::icas3::services::events::notifications::send::displayspeed_enabled {
  if( @this ) {
    if( !@icas3::services::events::notifications::send::displayspeed_notifications_enabled && 
      !@icas3::services::events::notifications::send::displayspeed_velocities_enabled ) {
      // enable controls
      @icas3::services::events::notifications::send::displayspeed_notifications_enabled = 1;
      @icas3::services::events::notifications::send::displayspeed_velocities_enabled = 1;
    }
    if( @icas3::services::events::cycletimes::displayspeed_cycletime ) setTimerCyclic(displayspeed_MsTimer, @icas3::services::events::cycletimes::displayspeed_cycletime);
  }
  else {
    cancelTimer(displayspeed_MsTimer);
  }
  checkboxes_enabled();
}

on timer displayspeed_MsTimer {
  sendFieldEvent(
    @icas3::services::events::notifications::send::displayspeed_velocities_enabled,
    @icas3::services::events::rnd::rnd_displayspeed_velocities,
    @icas3::services::events::opt::opt_displayspeed_velocities, 
    "DisplaySpeed::speeds", 
    displayspeed_velocities_members, 
    displayspeed_velocities_member_types,
    icas3_events_sent_namespace);

  sendFieldEvent(
    @icas3::services::events::notifications::send::displayspeed_notifications_enabled,
    @icas3::services::events::rnd::rnd_displayspeed_notifications,
    @icas3::services::events::opt::opt_displayspeed_notifications, 
    "DisplaySpeed::speedWarnings", 
    displayspeed_notifications_members, 
    displayspeed_notifications_member_types,
    icas3_events_sent_namespace);
}

// distance events
on sysvar sysvar::icas3::services::events::cycletimes::distance_cycletime {
  if(@icas3::services::events::notifications::send::distance_enabled) {
    // restart timer for distance 
    cancelTimer(distance_MsTimer);
    if( @this ) setTimerCyclic(distance_MsTimer, @this);
  }
}

on sysvar sysvar::icas3::services::events::notifications::send::distance_enabled {
  if( @this ) {
    // enable controls
    @icas3::services::events::notifications::send::distance_distances_enabled = 1;
    if( @icas3::services::events::cycletimes::distance_cycletime ) setTimerCyclic(distance_MsTimer, @icas3::services::events::cycletimes::distance_cycletime);
  }
  else {
    cancelTimer(distance_MsTimer);
  }
  checkboxes_enabled();
}

on timer distance_MsTimer {
  sendFieldEvent(
    @icas3::services::events::notifications::send::distance_distances_enabled,
    @icas3::services::events::rnd::rnd_distance_distances,
    @icas3::services::events::opt::opt_distance_distances, 
    "Distance::distances", 
    distance_distances_members, 
    distance_distances_member_types,
    icas3_events_sent_namespace);
}

// drivingstatistics events
on sysvar sysvar::icas3::services::events::cycletimes::drivingstatistics_cycletime {
  if(@icas3::services::events::notifications::send::drivingstatistics_enabled) {
    // restart timer for distance 
    cancelTimer(drivingstatistics_MsTimer);
    if( @this ) setTimerCyclic(drivingstatistics_MsTimer, @this);
  }
}

on sysvar sysvar::icas3::services::events::notifications::send::drivingstatistics_enabled {
  if( @this ) {
    if(!@icas3::services::events::notifications::send::drivingstatistics_distances_enabled && 
      !@icas3::services::events::notifications::send::drivingstatistics_durations_enabled &&
      !@icas3::services::events::notifications::send::drivingstatistics_speeds_enabled ) {
      // enable controls
      @icas3::services::events::notifications::send::drivingstatistics_distances_enabled = 1;
      @icas3::services::events::notifications::send::drivingstatistics_durations_enabled = 1;
      @icas3::services::events::notifications::send::drivingstatistics_speeds_enabled = 1;
    }
    if( @icas3::services::events::cycletimes::drivingstatistics_cycletime ) setTimerCyclic(drivingstatistics_MsTimer, @icas3::services::events::cycletimes::drivingstatistics_cycletime);
  }
  else {
    cancelTimer(drivingstatistics_MsTimer);
  }
  checkboxes_enabled();
}

on timer drivingstatistics_MsTimer {
  sendFieldEvent(
    @icas3::services::events::notifications::send::drivingstatistics_speeds_enabled,
    @icas3::services::events::rnd::rnd_drivingstatistics_speeds,
    @icas3::services::events::opt::opt_drivingstatistics_speeds, 
    "DrivingStatistics::speeds", 
    drivingstatistics_speeds_members, 
    drivingstatistics_speeds_member_types,
    icas3_events_sent_namespace);

  sendFieldEvent(
    @icas3::services::events::notifications::send::drivingstatistics_distances_enabled,
    @icas3::services::events::rnd::rnd_drivingstatistics_distances,
    @icas3::services::events::opt::opt_drivingstatistics_distances, 
    "DrivingStatistics::distances", 
    drivingstatistics_distances_members, 
    drivingstatistics_distances_member_types,
    icas3_events_sent_namespace);
 
  sendFieldEvent(
    @icas3::services::events::notifications::send::drivingstatistics_durations_enabled,
    @icas3::services::events::rnd::rnd_drivingstatistics_durations,
    @icas3::services::events::opt::opt_drivingstatistics_durations, 
    "DrivingStatistics::durations", 
    drivingstatistics_durations_members, 
    drivingstatistics_durations_member_types,
    icas3_events_sent_namespace);
}

// electricalconsumptions events
on sysvar sysvar::icas3::services::events::cycletimes::electricalconsumptions_cycletime {
  if(@icas3::services::events::notifications::send::electricalconsumptions_enabled) {
    // restart timer for distance 
    cancelTimer(electricalconsumptions_MsTimer);
    if( @this ) setTimerCyclic(electricalconsumptions_MsTimer, @this);
  }
}

on sysvar sysvar::icas3::services::events::notifications::send::electricalconsumptions_enabled {
  if( @this ) {
    if( !@icas3::services::events::notifications::send::electricalconsumptions_averageconsumptions_enabled && 
      !@icas3::services::events::notifications::send::electricalconsumptions_currentconsumptions_enabled ) {
      // enable controls
      @icas3::services::events::notifications::send::electricalconsumptions_averageconsumptions_enabled = 1;
      @icas3::services::events::notifications::send::electricalconsumptions_currentconsumptions_enabled = 1;
    }
    if( @icas3::services::events::cycletimes::electricalconsumptions_cycletime ) setTimerCyclic(electricalconsumptions_MsTimer, @icas3::services::events::cycletimes::electricalconsumptions_cycletime);
  }
  else {
    cancelTimer(electricalconsumptions_MsTimer);
  }
  checkboxes_enabled();
}

on timer electricalconsumptions_MsTimer {
  sendFieldEvent(
    @icas3::services::events::notifications::send::electricalconsumptions_averageconsumptions_enabled,
    @icas3::services::events::rnd::rnd_electricalconsumptions_averageconsumptions,
    @icas3::services::events::opt::opt_electricalconsumptions_averageconsumptions, 
    "ElectricalConsumptions::averageConsumptions", 
    electricalconsumptions_averageconsumptions_members, 
    electricalconsumptions_averageconsumptions_member_types,
    icas3_events_sent_namespace);

  sendFieldEvent(
    @icas3::services::events::notifications::send::electricalconsumptions_currentconsumptions_enabled,
    @icas3::services::events::rnd::rnd_electricalconsumptions_currentconsumptions,
    @icas3::services::events::opt::opt_electricalconsumptions_currentconsumptions, 
    "ElectricalConsumptions::currentConsumptions", 
    electricalconsumptions_currentconsumptions_members, 
    electricalconsumptions_currentconsumptions_member_types,
    icas3_events_sent_namespace); 
}

// temperature events
on sysvar sysvar::icas3::services::events::cycletimes::temperature_cycletime {
  if(@icas3::services::events::notifications::send::temperature_enabled) {
    // restart timer for distance 
    cancelTimer(temperature_MsTimer);
    if( @this ) setTimerCyclic(temperature_MsTimer, @this);
  }
}

on sysvar sysvar::icas3::services::events::notifications::send::temperature_enabled {
  if( @this ) {
    if( !@icas3::services::events::notifications::send::temperature_notifications_enabled &&
      !@icas3::services::events::notifications::send::temperature_temperatures_enabled ) {
      // enable controls
      @icas3::services::events::notifications::send::temperature_notifications_enabled = 1;
      @icas3::services::events::notifications::send::temperature_temperatures_enabled = 1;
    }
    if( @icas3::services::events::cycletimes::temperature_cycletime ) setTimerCyclic(temperature_MsTimer, @icas3::services::events::cycletimes::temperature_cycletime);
  }
  else {
    cancelTimer(temperature_MsTimer);
  }
  checkboxes_enabled();
}

on timer temperature_MsTimer {
  sendFieldEvent(
    @icas3::services::events::notifications::send::temperature_temperatures_enabled,
    @icas3::services::events::rnd::rnd_temperature_temperatures,
    @icas3::services::events::opt::opt_temperature_temperatures, 
    "Temperature::temperatures", 
    temperature_temperatures_members, 
    temperature_temperatures_member_types,
    icas3_events_sent_namespace);

  sendFieldEvent(
    @icas3::services::events::notifications::send::temperature_notifications_enabled,
    @icas3::services::events::rnd::rnd_temperature_notifications,
    @icas3::services::events::opt::opt_temperature_notifications, 
    "Temperature::temperatureWarnings", 
    temperature_notifications_members, 
    temperature_notifications_member_types,
    icas3_events_sent_namespace);
}

// unitmaster events
on sysvar sysvar::icas3::services::events::cycletimes::unitmaster_cycletime {
  if(@icas3::services::events::notifications::send::unitmaster_enabled) {
    // restart timer for unitmaster 
    cancelTimer(unitmaster_MsTimer);
    if( @this ) setTimerCyclic(unitmaster_MsTimer, @this);
  }
}

on sysvar sysvar::icas3::services::events::notifications::send::unitmaster_enabled {
  if( @this ) {
    // enable controls
    @icas3::services::events::notifications::send::unitmaster_units_enabled = 1;
    if( @icas3::services::events::cycletimes::unitmaster_cycletime ) setTimerCyclic(unitmaster_MsTimer, @icas3::services::events::cycletimes::unitmaster_cycletime);
  }
  else {
    // disable controls
    cancelTimer(unitmaster_MsTimer);
  }
  checkboxes_enabled();
}

on timer unitmaster_MsTimer {
  sendFieldEvent(
    @icas3::services::events::notifications::send::unitmaster_units_enabled,
    @icas3::services::events::rnd::rnd_unitmaster_units,
    0, //@icas3::services::events::optional::opt_unitmaster_units, 
    "UnitMaster::units", 
    unitmaster_units_members, 
    unitmaster_units_member_types,
    icas3_events_sent_namespace);
}

// checkboxes enabled

void checkboxes_enabled() {
  // get state 
  dword numSelected = 0;
  numSelected += @icas3::services::events::notifications::send::distance_enabled;
  numSelected += @icas3::services::events::notifications::send::displayspeed_enabled;
  numSelected += @icas3::services::events::notifications::send::drivingstatistics_enabled;
  numSelected += @icas3::services::events::notifications::send::electricalconsumptions_enabled;
  numSelected += @icas3::services::events::notifications::send::unitmaster_enabled;
  numSelected += @icas3::services::events::notifications::send::temperature_enabled;
  if(numSelected == 6) {
    @icas3::services::events::notifications::send::all_enabled = 1;
  }
  else if(numSelected == 0) {
    @icas3::services::events::notifications::send::all_enabled = 0;
  }
}

on sysvar icas3::services::events::notifications::send::all_enabled {
  if(@this) {
    @icas3::services::events::notifications::send::distance_enabled = 1;
    @icas3::services::events::notifications::send::displayspeed_enabled = 1;
    @icas3::services::events::notifications::send::drivingstatistics_enabled = 1;
    @icas3::services::events::notifications::send::electricalconsumptions_enabled = 1;
    @icas3::services::events::notifications::send::unitmaster_enabled = 1;  
    @icas3::services::events::notifications::send::temperature_enabled = 1;
  } else {
    @icas3::services::events::notifications::send::distance_enabled = 0;
    @icas3::services::events::notifications::send::displayspeed_enabled = 0;
    @icas3::services::events::notifications::send::drivingstatistics_enabled = 0;
    @icas3::services::events::notifications::send::electricalconsumptions_enabled = 0;
    @icas3::services::events::notifications::send::unitmaster_enabled = 0;
    @icas3::services::events::notifications::send::temperature_enabled = 0;
  }
}

// checkboxes rnd
on sysvar icas3::services::events::rnd::rnd_all {
  if(@this) {
    @icas3::services::events::rnd::rnd_distance_distances = 1;
    @icas3::services::events::rnd::rnd_displayspeed_notifications = 1;
    @icas3::services::events::rnd::rnd_displayspeed_velocities = 1;
    @icas3::services::events::rnd::rnd_drivingstatistics_distances = 1;
    @icas3::services::events::rnd::rnd_drivingstatistics_durations = 1;
    @icas3::services::events::rnd::rnd_drivingstatistics_speeds = 1;
    @icas3::services::events::rnd::rnd_electricalconsumptions_averageconsumptions = 1;
    @icas3::services::events::rnd::rnd_electricalconsumptions_currentconsumptions = 1;
    @icas3::services::events::rnd::rnd_unitmaster_units = 1;  
    @icas3::services::events::rnd::rnd_temperature_notifications = 1;
    @icas3::services::events::rnd::rnd_temperature_temperatures = 1;
    @icas3::services::events::rnd::rnd_tripcomputer_currentConsumptionsMulticast = 1; 
  } else {
    @icas3::services::events::rnd::rnd_distance_distances = 0;
    @icas3::services::events::rnd::rnd_displayspeed_notifications = 0;
    @icas3::services::events::rnd::rnd_displayspeed_velocities = 0;
    @icas3::services::events::rnd::rnd_drivingstatistics_distances = 0;
    @icas3::services::events::rnd::rnd_drivingstatistics_durations = 0;
    @icas3::services::events::rnd::rnd_drivingstatistics_speeds = 0;
    @icas3::services::events::rnd::rnd_electricalconsumptions_averageconsumptions = 0;
    @icas3::services::events::rnd::rnd_electricalconsumptions_currentconsumptions = 0;
    @icas3::services::events::rnd::rnd_unitmaster_units = 0;
    @icas3::services::events::rnd::rnd_temperature_notifications = 0;
    @icas3::services::events::rnd::rnd_temperature_temperatures = 0; 
    @icas3::services::events::rnd::rnd_tripcomputer_currentConsumptionsMulticast = 0;
  }
}

on sysvar (icas3::services::events::rnd::rnd_distance_distances |
    icas3::services::events::rnd::rnd_displayspeed_notifications |
    icas3::services::events::rnd::rnd_displayspeed_velocities |
    icas3::services::events::rnd::rnd_drivingstatistics_distances |
    icas3::services::events::rnd::rnd_drivingstatistics_durations |
    icas3::services::events::rnd::rnd_drivingstatistics_speeds |
    icas3::services::events::rnd::rnd_electricalconsumptions_averageconsumptions |
    icas3::services::events::rnd::rnd_electricalconsumptions_currentconsumptions |
    icas3::services::events::rnd::rnd_unitmaster_units |
    icas3::services::events::rnd::rnd_temperature_notifications |
    icas3::services::events::rnd::rnd_tripcomputer_currentConsumptionsMulticast |
    icas3::services::events::rnd::rnd_temperature_temperatures) {
  checkboxes_rnd();
}

void checkboxes_rnd() {
  // get state 
  dword numSelected;
  numSelected = 0;
  numSelected += @icas3::services::events::rnd::rnd_distance_distances ;
  numSelected += @icas3::services::events::rnd::rnd_displayspeed_notifications;
  numSelected += @icas3::services::events::rnd::rnd_displayspeed_velocities;
  numSelected += @icas3::services::events::rnd::rnd_drivingstatistics_distances;
  numSelected += @icas3::services::events::rnd::rnd_drivingstatistics_durations;
  numSelected += @icas3::services::events::rnd::rnd_drivingstatistics_speeds;
  numSelected += @icas3::services::events::rnd::rnd_electricalconsumptions_averageconsumptions;
  numSelected += @icas3::services::events::rnd::rnd_electricalconsumptions_currentconsumptions;
  numSelected += @icas3::services::events::rnd::rnd_unitmaster_units;  
  numSelected += @icas3::services::events::rnd::rnd_temperature_notifications;
  numSelected += @icas3::services::events::rnd::rnd_temperature_temperatures;
  numSelected += @icas3::services::events::rnd::rnd_tripcomputer_currentConsumptionsMulticast;
  if(numSelected == 11) {
    @icas3::services::events::rnd::rnd_all = 1;
  }
  else if(numSelected == 0) {
    @icas3::services::events::rnd::rnd_all = 0;
  }
}

// checkboxes opt
on sysvar icas3::services::events::opt::opt_all {
  if(@this) {
    @icas3::services::events::opt::opt_distance_distances = 1;
    @icas3::services::events::opt::opt_displayspeed_notifications = 1;
    @icas3::services::events::opt::opt_displayspeed_velocities = 1;
    @icas3::services::events::opt::opt_drivingstatistics_distances = 1;
    @icas3::services::events::opt::opt_drivingstatistics_durations = 1;
    @icas3::services::events::opt::opt_drivingstatistics_speeds = 1;
    @icas3::services::events::opt::opt_electricalconsumptions_averageconsumptions = 1;
    @icas3::services::events::opt::opt_electricalconsumptions_currentconsumptions = 1;
    @icas3::services::events::opt::opt_unitmaster_units = 1;  
    @icas3::services::events::opt::opt_temperature_notifications = 1;
    @icas3::services::events::opt::opt_temperature_temperatures = 1;
    @icas3::services::events::opt::opt_tripcomputer_currentConsumptionsMulticast = 1;
  } else {
    @icas3::services::events::opt::opt_distance_distances = 0;
    @icas3::services::events::opt::opt_displayspeed_notifications = 0;
    @icas3::services::events::opt::opt_displayspeed_velocities = 0;
    @icas3::services::events::opt::opt_drivingstatistics_distances = 0;
    @icas3::services::events::opt::opt_drivingstatistics_durations = 0;
    @icas3::services::events::opt::opt_drivingstatistics_speeds = 0;
    @icas3::services::events::opt::opt_electricalconsumptions_averageconsumptions = 0;
    @icas3::services::events::opt::opt_electricalconsumptions_currentconsumptions = 0;
    @icas3::services::events::opt::opt_unitmaster_units = 0;
    @icas3::services::events::opt::opt_temperature_notifications = 0;
    @icas3::services::events::opt::opt_temperature_temperatures = 0;
    @icas3::services::events::opt::opt_tripcomputer_currentConsumptionsMulticast = 0;
  }
}

on sysvar (icas3::services::events::opt::opt_distance_distances |
    icas3::services::events::opt::opt_displayspeed_notifications |
    icas3::services::events::opt::opt_displayspeed_velocities |
    icas3::services::events::opt::opt_drivingstatistics_distances |
    icas3::services::events::opt::opt_drivingstatistics_durations |
    icas3::services::events::opt::opt_drivingstatistics_speeds |
    icas3::services::events::opt::opt_electricalconsumptions_averageconsumptions |
    icas3::services::events::opt::opt_electricalconsumptions_currentconsumptions |
    icas3::services::events::opt::opt_unitmaster_units | 
    icas3::services::events::opt::opt_temperature_notifications |
    icas3::services::events::opt::opt_tripcomputer_currentConsumptionsMulticast |
    icas3::services::events::opt::opt_temperature_temperatures) {
  checkboxes_opt();
}

void checkboxes_opt() {
  // get state 
  dword numSelected = 0;
  numSelected += @icas3::services::events::opt::opt_distance_distances ;
  numSelected += @icas3::services::events::opt::opt_displayspeed_notifications;
  numSelected += @icas3::services::events::opt::opt_displayspeed_velocities;
  numSelected += @icas3::services::events::opt::opt_drivingstatistics_distances;
  numSelected += @icas3::services::events::opt::opt_drivingstatistics_durations;
  numSelected += @icas3::services::events::opt::opt_drivingstatistics_speeds;
  numSelected += @icas3::services::events::opt::opt_electricalconsumptions_averageconsumptions;
  numSelected += @icas3::services::events::opt::opt_electricalconsumptions_currentconsumptions;
  numSelected += @icas3::services::events::opt::opt_unitmaster_units;
  numSelected += @icas3::services::events::opt::opt_temperature_notifications;
  numSelected += @icas3::services::events::opt::opt_temperature_temperatures;
  numSelected += @icas3::services::events::opt::opt_tripcomputer_currentConsumptionsMulticast;
  if(numSelected == 11) {
    @icas3::services::events::opt::opt_all = 1;
  }
  else if(numSelected == 0) {
    @icas3::services::events::opt::opt_all = 0;
  }
}

// all_cycletime
on sysvar icas3::services::events::cycletimes::all_cycletime {
  // update all cycle times
  @icas3::services::events::cycletimes::displayspeed_cycletime = @this;
  @icas3::services::events::cycletimes::distance_cycletime = @this;
  @icas3::services::events::cycletimes::drivingstatistics_cycletime = @this;
  @icas3::services::events::cycletimes::electricalconsumptions_cycletime = @this;
  @icas3::services::events::cycletimes::temperature_cycletime = @this;
  @icas3::services::events::cycletimes::unitmaster_cycletime = @this;
  @icas3::services::events::cycletimes::tripcomputer_cycletime = @this;
}

// Reception statistics
void initialize_event_notifiers() {
  // Subscribe to notifier events
  SomeIpRegisterCallback(SomeIpGetConsumedObjectHandle("Chassis::velocityInfo"), "Chassis_velocityInfoNotifier");
  SomeIpRegisterCallback(SomeIpGetConsumedObjectHandle("Chassis::notifications"), "Chassis_notifictaionsNotifier");
  SomeIpRegisterCallback(SomeIpGetConsumedObjectHandle("Chassis::espSystemInfo"), "Chassis_espSystemInfoNotifier");
  SomeIpRegisterCallback(SomeIpGetConsumedObjectHandle("Chassis::axes"), "Chassis_axesNotifier");
  SomeIpRegisterCallback(SomeIpGetConsumedObjectHandle("Chassis::wheels"), "Chassis_wheelsNotifier");
  
  SomeIpRegisterCallback(SomeIpGetConsumedObjectHandle("ClampControl::clamps"), "ClampControl_clampsNotifier");
  SomeIpRegisterCallback(SomeIpGetConsumedObjectHandle("ClampControl::notifications"), "ClampControl_notificationsNotifier");
  
  SomeIpRegisterCallback(SomeIpGetConsumedObjectHandle("ClimateControl::status"), "ClimateControl_statusNotifier");
  SomeIpRegisterCallback(SomeIpGetConsumedObjectHandle("ClimateControl::notifications"), "ClimateControl_notificationsNotifier");
  SomeIpRegisterCallback(SomeIpGetConsumedObjectHandle("ClimateControl::consumptions"), "ClimateControl_consumptionsNotifier");
  
  SomeIpRegisterCallback(SomeIpGetConsumedObjectHandle("DiagnosticDataDistribution::dataValuesHash"), "DiagnosticDataDistribution_dataValuesHashNotifier");
  
  SomeIpRegisterCallback(SomeIpGetConsumedObjectHandle("EnergySystem::highVoltageBatteries"), "EnergySystem_highVoltageBatteriesNotifier");
  SomeIpRegisterCallback(SomeIpGetConsumedObjectHandle("EnergySystem::lowVoltageBatteries"), "EnergySystem_lowVoltageBatteriesNotifier");
  SomeIpRegisterCallback(SomeIpGetConsumedObjectHandle("EnergySystem::lowVoltageSystemInfo"), "EnergySystem_lowVoltageSystemInfoNotifier");
  SomeIpRegisterCallback(SomeIpGetConsumedObjectHandle("EnergySystem::notifications"), "EnergySystem_notificationsNotifier");
  
  SomeIpRegisterCallback(SomeIpGetConsumedObjectHandle("Engine::notifications"), "Engine_notificationsNotifier");
  SomeIpRegisterCallback(SomeIpGetConsumedObjectHandle("Engine::engineInformation"), "Engine_engineInformationNotifier");
  SomeIpRegisterCallback(SomeIpGetConsumedObjectHandle("Engine::powerMeterParameters"), "Engine_powerMeterParametersNotifier");
  SomeIpRegisterCallback(SomeIpGetConsumedObjectHandle("Engine::electricPerformanceCharacteristics"), "Engine_electricPerformanceCharacteristicsNotifier");

  SomeIpRegisterCallback(SomeIpGetConsumedObjectHandle("EnvironmentalSensorData::sensorData"), "EnvironmentalSensorData_sensorDataNotifier");
  
  SomeIpRegisterCallback(SomeIpGetConsumedObjectHandle("ExteriorLight::lightFunctions"), "ExteriorLight_lightFunctionsNotifier");
  SomeIpRegisterCallback(SomeIpGetConsumedObjectHandle("ExteriorLight::lightFunctionControls"), "ExteriorLight_lightFunctionControlsNotifier");
  SomeIpRegisterCallback(SomeIpGetConsumedObjectHandle("ExteriorLight::lamps"), "ExteriorLight_lampsNotifier");
  SomeIpRegisterCallback(SomeIpGetConsumedObjectHandle("ExteriorLight::info"), "ExteriorLight_infoNotifier");
  SomeIpRegisterCallback(SomeIpGetConsumedObjectHandle("ExteriorLight::lightButtonModules"), "ExteriorLight_lightButtonModulesNotifier");
  SomeIpRegisterCallback(SomeIpGetConsumedObjectHandle("ExteriorLight::notifications"), "ExteriorLight_notificationsNotifier");
  
  SomeIpRegisterCallback(SomeIpGetConsumedObjectHandle("ExteriorSound::notifications"), "ExteriorSound_notificationsNotifier");

  SomeIpRegisterCallback(SomeIpGetConsumedObjectHandle("HighVoltageCoordinator::notifications"), "HighVoltageCoordinator_notificationsNotifier");
  
  SomeIpRegisterCallback(SomeIpGetConsumedObjectHandle("Immobilizer::notifications"), "Immobilizer_notificationsNotifier");
  SomeIpRegisterCallback(SomeIpGetConsumedObjectHandle("Immobilizer::info"), "Immobilizer_infoNotifier");
  
  SomeIpRegisterCallback(SomeIpGetConsumedObjectHandle("Odometry::accelerations"), "Odometry_accelerationsNotifier");
  SomeIpRegisterCallback(SomeIpGetConsumedObjectHandle("Odometry::velocities"), "Odometry_velocitiesNotifier");

  SomeIpRegisterCallback(SomeIpGetConsumedObjectHandle("Powertrain::notifications"), "Powertrain_notificationsNotifier");
  SomeIpRegisterCallback(SomeIpGetConsumedObjectHandle("Powertrain::displayValues"), "Powertrain_displayValuesNotifier");
  SomeIpRegisterCallback(SomeIpGetConsumedObjectHandle("Powertrain::status"), "Powertrain_statusNotifier");

  SomeIpRegisterCallback(SomeIpGetConsumedObjectHandle("PowertrainConsumption::electricDriveMotors"), "PowertrainConsumption_electricDriveMotorsNotifier");
  
  SomeIpRegisterCallback(SomeIpGetConsumedObjectHandle("SafetyBeltState::notifications"), "SafetyBeltState_notificationsNotifier");
  SomeIpRegisterCallback(SomeIpGetConsumedObjectHandle("SafetyBeltState::belts"), "SafetyBeltState_beltsNotifier");
  
  SomeIpRegisterCallback(SomeIpGetConsumedObjectHandle("Time::times"), "Time_timesNotifier");
  SomeIpRegisterCallback(SomeIpGetConsumedObjectHandle("Time::timeSettings"), "Time_timeSettingsNotifier");

  SomeIpRegisterCallback(SomeIpGetConsumedObjectHandle("VehicleBasicData::installations"), "VehicleBasicData_installationsNotifier");
  SomeIpRegisterCallback(SomeIpGetConsumedObjectHandle("VehicleBasicData::variants"), "VehicleBasicData_variantsNotifier");
  SomeIpRegisterCallback(SomeIpGetConsumedObjectHandle("VehicleBasicData::parameters"), "VehicleBasicData_parametersNotifier");
}

// Chassis
void Chassis_velocityInfoNotifier(dword fieldHandle, dword messageHandle)
{
  @icas3::services::events::notifications::received::chassis_velocityInfo += 1;
  setControlProperty(gPanelName, "received_chassis_velocityInfo", "Text", @icas3::services::events::notifications::received::chassis_velocityInfo);
}

void Chassis_notifictaionsNotifier(dword fieldHandle, dword messageHandle)
{
  @icas3::services::events::notifications::received::chassis_notifications += 1;
  setControlProperty(gPanelName, "received_chassis_notifications", "Text", @icas3::services::events::notifications::received::chassis_notifications);
}

void Chassis_espSystemInfoNotifier(dword fieldHandle, dword messageHandle)
{
  @icas3::services::events::notifications::received::chassis_espSystemInfo += 1;
  setControlProperty(gPanelName, "received_chassis_espSystemInfo", "Text", @icas3::services::events::notifications::received::chassis_espSystemInfo);
}

void Chassis_axesNotifier(dword fieldHandle, dword messageHandle)
{
  @icas3::services::events::notifications::received::chassis_axes += 1;
  setControlProperty(gPanelName, "received_chassis_axes", "Text", @icas3::services::events::notifications::received::chassis_axes);
}

void Chassis_wheelsNotifier(dword fieldHandle, dword messageHandle)
{
  @icas3::services::events::notifications::received::chassis_wheels += 1;
  setControlProperty(gPanelName, "received_chassis_wheels", "Text", @icas3::services::events::notifications::received::chassis_wheels);
}

// ClampControl
void ClampControl_clampsNotifier(dword fieldHandle, dword messageHandle)
{
  @icas3::services::events::notifications::received::clampcontrol_clamps += 1;
  setControlProperty(gPanelName, "received_clampcontrol_clamps", "Text", @icas3::services::events::notifications::received::clampcontrol_clamps);
}

void ClampControl_notificationsNotifier(dword fieldHandle, dword messageHandle)
{
  @icas3::services::events::notifications::received::clampcontrol_notifications += 1;
  setControlProperty(gPanelName, "received_clampcontrol_notifications", "Text", @icas3::services::events::notifications::received::clampcontrol_notifications);
}

// ClimateControl
void ClimateControl_statusNotifier(dword fieldHandle, dword messageHandle)
{
  @icas3::services::events::notifications::received::climatecontrol_status += 1;
  setControlProperty(gPanelName, "received_climatecontrol_status", "Text", @icas3::services::events::notifications::received::climatecontrol_status);
}

void ClimateControl_notificationsNotifier(dword fieldHandle, dword messageHandle)
{
  @icas3::services::events::notifications::received::climatecontrol_notifications += 1;
  setControlProperty(gPanelName, "received_climatecontrol_notifications", "Text", @icas3::services::events::notifications::received::climatecontrol_notifications);
}

void ClimateControl_consumptionsNotifier(dword fieldHandle, dword messageHandle)
{
  @icas3::services::events::notifications::received::climatecontrol_consumptions += 1;
  setControlProperty(gPanelName, "received_climatecontrol_consumptions", "Text", @icas3::services::events::notifications::received::climatecontrol_consumptions);
}

// DiagnosticDataDistribution
void DiagnosticDataDistribution_dataValuesHashNotifier(dword fieldHandle, dword messageHandle)
{
  @icas3::services::events::notifications::received::diagnosticdatadistribution_dataValuesHash += 1;
  setControlProperty(gPanelName, "received_diagnosticdatadistribution_dataValuesHash", "Text", @icas3::services::events::notifications::received::diagnosticdatadistribution_dataValuesHash);
}

// EnergySystem
void EnergySystem_highVoltageBatteriesNotifier(dword fieldHandle, dword messageHandle)
{
  @icas3::services::events::notifications::received::energysystem_highVoltageBatteries += 1;
  setControlProperty(gPanelName, "received_energysystem_highVoltageBatteries", "Text", @icas3::services::events::notifications::received::energysystem_highVoltageBatteries);
}

void EnergySystem_lowVoltageBatteriesNotifier(dword fieldHandle, dword messageHandle)
{
  @icas3::services::events::notifications::received::energysystem_lowVoltageBatteries += 1;
  setControlProperty(gPanelName, "received_energysystem_lowVoltageBatteries", "Text", @icas3::services::events::notifications::received::energysystem_lowVoltageBatteries);
}

void EnergySystem_lowVoltageSystemInfoNotifier(dword fieldHandle, dword messageHandle)
{
  @icas3::services::events::notifications::received::energysystem_lowVoltageSystemInfo += 1;
  setControlProperty(gPanelName, "received_energysystem_lowVoltageSystemInfo", "Text", @icas3::services::events::notifications::received::energysystem_lowVoltageSystemInfo);
}

void EnergySystem_notificationsNotifier(dword fieldHandle, dword messageHandle)
{
  @icas3::services::events::notifications::received::energysystem_notifications += 1;
  setControlProperty(gPanelName, "received_energysystem_notifications", "Text", @icas3::services::events::notifications::received::energysystem_notifications);
}

// Engine
void Engine_notificationsNotifier(dword fieldHandle, dword messageHandle)
{
  @icas3::services::events::notifications::received::engine_notifications += 1;
  setControlProperty(gPanelName, "received_engine_notifications", "Text", @icas3::services::events::notifications::received::engine_notifications);
}

void Engine_engineInformationNotifier(dword fieldHandle, dword messageHandle)
{
  @icas3::services::events::notifications::received::engine_engineInformation += 1;
  setControlProperty(gPanelName, "received_engine_engineInformation", "Text", @icas3::services::events::notifications::received::engine_engineInformation);
}

void Engine_powerMeterParametersNotifier(dword fieldHandle, dword messageHandle)
{
  @icas3::services::events::notifications::received::engine_powerMeterParameters += 1;
  setControlProperty(gPanelName, "received_engine_powerMeterParameters", "Text", @icas3::services::events::notifications::received::engine_powerMeterParameters);
}

void Engine_electricPerformanceCharacteristicsNotifier(dword fieldHandle, dword messageHandle)
{
  @icas3::services::events::notifications::received::engine_electricPerformanceCharacteristics += 1;
  setControlProperty(gPanelName, "received_engine_electricPerformanceCharacteristics", "Text", @icas3::services::events::notifications::received::engine_electricPerformanceCharacteristics);
}

// EnvironmentalSensorData
void EnvironmentalSensorData_sensorDataNotifier(dword fieldHandle, dword messageHandle)
{
  @icas3::services::events::notifications::received::environmentalsensordata_sensorData += 1;
  setControlProperty(gPanelName, "received_environmentalsensordata_sensorData", "Text", @icas3::services::events::notifications::received::environmentalsensordata_sensorData);
}

// ExteriorLight
void ExteriorLight_lightFunctionsNotifier(dword fieldHandle, dword messageHandle)
{
  @icas3::services::events::notifications::received::exteriorlight_lightFunctions += 1;
  setControlProperty(gPanelName, "received_exteriorlight_lightFunctions", "Text", @icas3::services::events::notifications::received::exteriorlight_lightFunctions);
}

void ExteriorLight_lightFunctionControlsNotifier(dword fieldHandle, dword messageHandle)
{
  @icas3::services::events::notifications::received::exteriorlight_lightFunctionControls += 1;
  setControlProperty(gPanelName, "received_exteriorlight_lightFunctionControls", "Text", @icas3::services::events::notifications::received::exteriorlight_lightFunctionControls);
}

void ExteriorLight_lampsNotifier(dword fieldHandle, dword messageHandle)
{
  @icas3::services::events::notifications::received::exteriorlight_lamps += 1;
  setControlProperty(gPanelName, "received_exteriorlight_lamps", "Text", @icas3::services::events::notifications::received::exteriorlight_lamps);
}

void ExteriorLight_infoNotifier(dword fieldHandle, dword messageHandle)
{
  @icas3::services::events::notifications::received::exteriorlight_info += 1;
  setControlProperty(gPanelName, "received_exteriorlight_info", "Text", @icas3::services::events::notifications::received::exteriorlight_info);
}

void ExteriorLight_lightButtonModulesNotifier(dword fieldHandle, dword messageHandle)
{
  @icas3::services::events::notifications::received::exteriorlight_lightButtonModules += 1;
  setControlProperty(gPanelName, "received_exteriorlight_lightButtonModules", "Text", @icas3::services::events::notifications::received::exteriorlight_lightButtonModules);
}

void ExteriorLight_notificationsNotifier(dword fieldHandle, dword messageHandle)
{
  @icas3::services::events::notifications::received::exteriorlight_notifications += 1;
  setControlProperty(gPanelName, "received_exteriorlight_notifications", "Text", @icas3::services::events::notifications::received::exteriorlight_notifications);
}

// ExteriorSound
void ExteriorSound_notificationsNotifier(dword fieldHandle, dword messageHandle)
{
  @icas3::services::events::notifications::received::exteriorsound_notifications += 1;
  setControlProperty(gPanelName, "received_exteriorsound_notifications", "Text", @icas3::services::events::notifications::received::exteriorsound_notifications);
}

// HighVoltageCoordinator
void HighVoltageCoordinator_notificationsNotifier(dword fieldHandle, dword messageHandle)
{
  @icas3::services::events::notifications::received::highvoltagecoordinator_notifications += 1;
  setControlProperty(gPanelName, "received_highvoltagecoordinator_notifications", "Text", @icas3::services::events::notifications::received::highvoltagecoordinator_notifications);
}

// Immobilizer
void Immobilizer_notificationsNotifier(dword fieldHandle, dword messageHandle)
{
  @icas3::services::events::notifications::received::immobilizer_notifications += 1;
  setControlProperty(gPanelName, "received_immobilizer_notifications", "Text", @icas3::services::events::notifications::received::immobilizer_notifications);
}

void Immobilizer_infoNotifier(dword fieldHandle, dword messageHandle)
{
  @icas3::services::events::notifications::received::immobilizer_info += 1;
  setControlProperty(gPanelName, "received_immobilizer_info", "Text", @icas3::services::events::notifications::received::immobilizer_info);
}

// Odometry
void Odometry_accelerationsNotifier(dword fieldHandle, dword messageHandle)
{
  @icas3::services::events::notifications::received::odometry_motion += 1;
  setControlProperty(gPanelName, "received_odometry_accelerations", "Text", @icas3::services::events::notifications::received::odometry_motion);
}

void Odometry_velocitiesNotifier(dword fieldHandle, dword messageHandle)
{
  @icas3::services::events::notifications::received::odometry_velocities += 1;
  setControlProperty(gPanelName, "received_odometry_velocities", "Text", @icas3::services::events::notifications::received::odometry_velocities);
}

// Powertrain
void Powertrain_notificationsNotifier(dword fieldHandle, dword messageHandle)
{
  @icas3::services::events::notifications::received::powertrain_notifications += 1;
  setControlProperty(gPanelName, "received_powertrain_notifications", "Text", @icas3::services::events::notifications::received::powertrain_notifications);
}

void Powertrain_displayValuesNotifier(dword fieldHandle, dword messageHandle)
{
  @icas3::services::events::notifications::received::powertrain_settings += 1;
  setControlProperty(gPanelName, "received_powertrain_settings", "Text", @icas3::services::events::notifications::received::powertrain_settings);
}

void Powertrain_statusNotifier(dword fieldHandle, dword messageHandle)
{
  @icas3::services::events::notifications::received::powertrain_status += 1;
  setControlProperty(gPanelName, "received_powertrain_status", "Text", @icas3::services::events::notifications::received::powertrain_status);
}

// PowertrainConsumption
void PowertrainConsumption_electricDriveMotorsNotifier(dword fieldHandle, dword messageHandle)
{
  @icas3::services::events::notifications::received::powertrainconsumption_electricDriveMotors += 1;
  setControlProperty(gPanelName, "received_powertrainconsumption_electricDriveMotors", "Text", @icas3::services::events::notifications::received::powertrainconsumption_electricDriveMotors);
}

// SafetyBeltState
void SafetyBeltState_notificationsNotifier(dword fieldHandle, dword messageHandle)
{
  @icas3::services::events::notifications::received::safetybeltstate_notifications += 1;
  setControlProperty(gPanelName, "received_safetybeltstate_notifications", "Text", @icas3::services::events::notifications::received::safetybeltstate_notifications);
}

void SafetyBeltState_beltsNotifier(dword fieldHandle, dword messageHandle)
{
  @icas3::services::events::notifications::received::safetybeltstate_belts += 1;
  setControlProperty(gPanelName, "received_safetybeltstate_belts", "Text", @icas3::services::events::notifications::received::safetybeltstate_belts);
}

// Time
void Time_timesNotifier(dword fieldHandle, dword messageHandle)
{
  @icas3::services::events::notifications::received::time_times += 1;
  setControlProperty(gPanelName, "received_time_times", "Text", @icas3::services::events::notifications::received::time_times);
}

void Time_timeSettingsNotifier(dword fieldHandle, dword messageHandle)
{
  @icas3::services::events::notifications::received::time_timeSettings += 1;
  setControlProperty(gPanelName, "received_time_timeSettings", "Text", @icas3::services::events::notifications::received::time_timeSettings);
}

// VehicleBasicData
void VehicleBasicData_installationsNotifier(dword fieldHandle, dword messageHandle)
{
  @icas3::services::events::notifications::received::vehiclebasicdata_installations += 1;
  setControlProperty(gPanelName, "received_vehiclebasicdata_installations", "Text", @icas3::services::events::notifications::received::vehiclebasicdata_installations);
}

void VehicleBasicData_variantsNotifier(dword fieldHandle, dword messageHandle)
{
  @icas3::services::events::notifications::received::vehiclebasicdata_variants += 1;
  setControlProperty(gPanelName, "received_vehiclebasicdata_variants", "Text", @icas3::services::events::notifications::received::vehiclebasicdata_variants);
}

void VehicleBasicData_parametersNotifier(dword fieldHandle, dword messageHandle)
{
  @icas3::services::events::notifications::received::vehiclebasicdata_parameters += 1;
  setControlProperty(gPanelName, "received_vehiclebasicdata_parameters", "Text", @icas3::services::events::notifications::received::vehiclebasicdata_parameters);
}
